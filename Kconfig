## Kconfig
```kconfig
# SPDX-License-Identifier: MIT

menu "Keyball peer features"

config KEYBALL_PEER_LAYER_SYNC
	bool "Independent-half layer synchronization"
	depends on ZMK_BLE
	help
	  Keep each half as an independent host-facing ZMK keyboard while
	  broadcasting local layer state to its peer over connectionless BLE.

if KEYBALL_PEER_LAYER_SYNC

config KEYBALL_PEER_FAMILY
	int "Keyboard family identifier"
	range 1 255
	help
	  Must match on both halves. Keyball44 uses 44 and Keyball61 uses 61.

config KEYBALL_PEER_SIDE
	int "Side identifier (0 left, 1 right)"
	range 0 1
	help
	  Prevents a half from accepting packets sent by another half configured
	  for the same side.

config KEYBALL_PEER_TIMEOUT_MS
	int "Peer layer timeout in milliseconds"
	range 500 10000
	default 2500
	help
	  Remove remotely contributed layers if peer advertisements stop arriving.

config KEYBALL_PEER_ENROLL_HOLD_MS
	int "Peer enrollment chord hold time in milliseconds"
	range 1000 10000
	default 3000
	help
	  Hold the local enrollment chord this long to erase only the saved peer
	  relationship and open a new enrollment window.

config KEYBALL_PEER_ENROLL_TIMEOUT_MS
	int "Peer enrollment window in milliseconds"
	range 10000 300000
	default 60000
	help
	  Stop accepting enrollment packets if no opposite-side peer completes
	  the handshake within this interval.

config KEYBALL_PEER_ENROLL_MIN_RSSI
	int "Minimum enrollment signal strength (dBm)"
	range -100 -20
	default -55
	help
	  Ignore enrollment requests weaker than this value. Put the intended
	  halves close together while enrolling them.

config KEYBALL_PEER_INIT_PRIORITY
	int "Peer synchronization initialization priority"
	default 99
	help
	  Must run after ZMK initializes Bluetooth and its keymap.

endif

endmenu

menu "Keyball universal pointer"

config KEYBALL_UNIVERSAL_POINTER
	bool "Startup probing for Cirque I2C or PMW3360 SPI"
	depends on GPIO && I2C && SPI && INPUT
	help
	  Keep the shared pins in an input-safe state, hold PMW3360 NCS inactive,
	  and bit-bang a read-only Cirque FirmwareId probe at I2C address 0x2A.
	  If Cirque is absent, initialize SPI and verify the PMW3360 Product_ID.
	  No module-side identity straps are required.

config KEYBALL_POINTER_DETECT_INIT_PRIORITY
	int "Universal pointer detection initialization priority"
	depends on KEYBALL_UNIVERSAL_POINTER
	default 80
	help
	  APPLICATION-level priority used to select and initialize one pointer.

endmenu
```

## config/boards/shields/keyball44/Kconfig.defconfig
```kconfig
if SHIELD_KEYBALL44_RIGHT_CIRQUE || SHIELD_KEYBALL44_RIGHT_PMW3360

config ZMK_KEYBOARD_NAME
    default "Keyball44"

config ZMK_SPLIT_ROLE_CENTRAL
    default y

config INPUT
    default y

config ZMK_POINTING
    default y

endif

if SHIELD_KEYBALL44_LEFT_STANDALONE

config ZMK_KEYBOARD_NAME
    default "KB44 Left"

endif

if SHIELD_KEYBALL44_LEFT_PEER

config ZMK_KEYBOARD_NAME
    default "KB44 L Peer"

endif

if SHIELD_KEYBALL44_RIGHT_CIRQUE_STANDALONE || SHIELD_KEYBALL44_RIGHT_PMW3360_STANDALONE

config ZMK_KEYBOARD_NAME
    default "KB44 Right"

config INPUT
    default y

config ZMK_POINTING
    default y

endif

if SHIELD_KEYBALL44_RIGHT_CIRQUE_PEER || SHIELD_KEYBALL44_RIGHT_PMW3360_PEER

config ZMK_KEYBOARD_NAME
    default "KB44 R Peer"

config INPUT
    default y

config ZMK_POINTING
    default y

endif

if SHIELD_KEYBALL44_RIGHT_CIRQUE || SHIELD_KEYBALL44_RIGHT_CIRQUE_STANDALONE || SHIELD_KEYBALL44_RIGHT_CIRQUE_PEER

config I2C
    default y

endif

if SHIELD_KEYBALL44_RIGHT_PMW3360 || SHIELD_KEYBALL44_RIGHT_PMW3360_STANDALONE || SHIELD_KEYBALL44_RIGHT_PMW3360_PEER

config SPI
    default y

endif

if SHIELD_KEYBALL44_LEFT || SHIELD_KEYBALL44_RIGHT_CIRQUE || SHIELD_KEYBALL44_RIGHT_PMW3360

config ZMK_SPLIT
    default y

endif
```

## config/boards/shields/keyball44/Kconfig.shield
```kconfig
config SHIELD_KEYBALL44_LEFT
    def_bool $(shields_list_contains,keyball44_left)

config SHIELD_KEYBALL44_LEFT_STANDALONE
    def_bool $(shields_list_contains,keyball44_left_standalone)

config SHIELD_KEYBALL44_LEFT_PEER
    def_bool $(shields_list_contains,keyball44_left_peer)

config SHIELD_KEYBALL44_RIGHT_CIRQUE
    def_bool $(shields_list_contains,keyball44_right_cirque)

config SHIELD_KEYBALL44_RIGHT_CIRQUE_STANDALONE
    def_bool $(shields_list_contains,keyball44_right_cirque_standalone)

config SHIELD_KEYBALL44_RIGHT_CIRQUE_PEER
    def_bool $(shields_list_contains,keyball44_right_cirque_peer)

config SHIELD_KEYBALL44_RIGHT_PMW3360
    def_bool $(shields_list_contains,keyball44_right_pmw3360)

config SHIELD_KEYBALL44_RIGHT_PMW3360_STANDALONE
    def_bool $(shields_list_contains,keyball44_right_pmw3360_standalone)

config SHIELD_KEYBALL44_RIGHT_PMW3360_PEER
    def_bool $(shields_list_contains,keyball44_right_pmw3360_peer)
```

## config/boards/shields/keyball61/Kconfig.defconfig
```kconfig
if SHIELD_KEYBALL61_RIGHT

config ZMK_KEYBOARD_NAME
    default "Keyball61 C40"

config ZMK_SPLIT_ROLE_CENTRAL
    default y

config I2C
    default y

config INPUT
    default y

config ZMK_POINTING
    default y

endif

if SHIELD_KEYBALL61_LEFT_PEER || SHIELD_KEYBALL61_LEFT_UNIVERSAL_PEER

config ZMK_KEYBOARD_NAME
    default "KB61 L Peer"

endif

if SHIELD_KEYBALL61_RIGHT_PEER || SHIELD_KEYBALL61_RIGHT_UNIVERSAL_PEER

config ZMK_KEYBOARD_NAME
    default "KB61 R Peer"

config I2C
    default y

config INPUT
    default y

config ZMK_POINTING
    default y

endif

if SHIELD_KEYBALL61_LEFT_UNIVERSAL_PEER || SHIELD_KEYBALL61_RIGHT_UNIVERSAL_PEER

config I2C
    default y

config SPI
    default y

config INPUT
    default y

config ZMK_POINTING
    default y

endif

if SHIELD_KEYBALL61_LEFT || SHIELD_KEYBALL61_RIGHT

config ZMK_SPLIT
    default y

endif
```

## config/boards/shields/keyball61/Kconfig.shield
```kconfig
config SHIELD_KEYBALL61_LEFT
    def_bool $(shields_list_contains,keyball61_left)

config SHIELD_KEYBALL61_LEFT_PEER
    def_bool $(shields_list_contains,keyball61_left_peer)

config SHIELD_KEYBALL61_RIGHT
    def_bool $(shields_list_contains,keyball61_right)

config SHIELD_KEYBALL61_RIGHT_PEER
    def_bool $(shields_list_contains,keyball61_right_peer)
```

## dts/bindings/behaviors/keyball,behavior-peer-enroll.yaml
```yaml
description: Keyball peer enrollment long-hold behavior

compatible: "keyball,behavior-peer-enroll"

include: zero_param.yaml
```

## dts/bindings/misc/keyball,pointer-autodetect.yaml
```yaml
description: Keyball shared-connector pointer protocol detector

compatible: "keyball,pointer-autodetect"

include: base.yaml

properties:
  scl-gpios:
    type: phandle-array
    required: true
    description: Shared Cirque SCL and PMW3360 SCLK pin

  sda-gpios:
    type: phandle-array
    required: true
    description: Shared Cirque SDA and PMW3360 MISO pin

  mosi-dr-gpios:
    type: phandle-array
    required: true
    description: Shared Cirque HW_DR and PMW3360 MOSI pin

  cs-gpios:
    type: phandle-array
    required: true
    description: PMW3360 active-low chip-select pin; unused by the Cirque adapter

  cirque:
    type: phandle
    required: true
    description: Deferred Cirque Pinnacle device

  pmw3360:
    type: phandle
    required: true
    description: Deferred PMW3360 device
```
